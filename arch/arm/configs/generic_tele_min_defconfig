## arch/arm/configs/generic_tele_min_defconfig
```kconfig
CONFIG_ARCH_QCOM=y
CONFIG_QCOM_DCC_V2=y
CONFIG_QCOM_GLINK=y
CONFIG_QCOM_GLINK_PKT=y
CONFIG_HWSPINLOCK=y
CONFIG_HWSPINLOCK_QCOM=y
CONFIG_IKCONFIG=y
CONFIG_IKCONFIG_PROC=y
CONFIG_MSM_QMP=y
CONFIG_QCOM_AOSS_QMP=y
CONFIG_QCOM_SMEM=y
CONFIG_QCOM_SMEM_STATE=y
CONFIG_QCOM_SMP2P=y
CONFIG_RPMSG_QCOM_GLINK=y
CONFIG_RPMSG_QCOM_GLINK_SMEM=y
# CONFIG_FIPS_SIGNATURE_SELFTEST is not set
CONFIG_QRTR=y
CONFIG_QRTR_NODE_ID=1
CONFIG_QRTR_SMD=y
CONFIG_QRTR_WAKEUP_MS=500
CONFIG_QCOM_MEMORY_DUMP_V2=y
CONFIG_MODULE_SCMVERSION=y
CONFIG_MODULE_SIG=y
CONFIG_MODULE_SIG_ALL=y
CONFIG_MODULE_UNLOAD=y
# CONFIG_MODULE_UNLOAD_TAINT_TRACKING is not set
CONFIG_MODVERSIONS=y
CONFIG_MODULE_SIG_FORMAT=y
CONFIG_MODULE_SIG_HASH="sha1"
CONFIG_MODULE_SIG_KEY="certs/signing_key.pem"
# CONFIG_MODULE_SIG_KEY_TYPE_ECDSA is not set
CONFIG_MODULE_SIG_KEY_TYPE_RSA=y
CONFIG_MODULE_SIG_SHA1=y
# CONFIG_MODULE_SIG_SHA224 is not set
# CONFIG_MODULE_SIG_SHA256 is not set
# CONFIG_MODULE_SIG_SHA384 is not set
# CONFIG_MODULE_SIG_SHA512 is not set
CONFIG_PKCS7_MESSAGE_PARSER=y
# CONFIG_PKCS7_TEST_KEY is not set
# CONFIG_SIGNED_PE_FILE_VERIFICATION is not set
CONFIG_SYSTEM_DATA_VERIFICATION=y
CONFIG_SGL_ALLOC=y
CONFIG_BRIDGE=y
CONFIG_DEVTMPFS_MOUNT=y
CONFIG_DEVTMPFS_SAFE=y
CONFIG_DEVTMPFS=y
CONFIG_INET=y
CONFIG_IP_ADVANCED_ROUTER=y
CONFIG_IP_MULTICAST=y
CONFIG_IP_MULTIPLE_TABLES=y
CONFIG_IP_NF_FILTER=y
CONFIG_IP_NF_IPTABLES=y
CONFIG_IP_NF_MANGLE=y
CONFIG_IP_NF_NAT=y
CONFIG_IP_NF_RAW=y
CONFIG_IP_NF_TARGET_MASQUERADE=y
CONFIG_IP_NF_TARGET_REDIRECT=y
CONFIG_IP_NF_TARGET_REJECT=y
CONFIG_MEMFD_CREATE=y
CONFIG_NETDEVICES=y
CONFIG_NETFILTER=y
CONFIG_NET_SCHED=y
CONFIG_NET_SCH_HTB=y
CONFIG_NET_SCH_PRIO=y
CONFIG_NET_SCH_TBF=y
CONFIG_NET=y
CONFIG_NF_CONNTRACK=y
CONFIG_PACKET=y
CONFIG_PPP=y
CONFIG_PROC_CHILDREN=y
CONFIG_PRINTK_TIME=y
CONFIG_TMPFS=y
CONFIG_TUN=y
CONFIG_UNIX=y
CONFIG_USB_DWC3=y
CONFIG_USB_GADGET=y
```

## drivers/edac/Kconfig
```kconfig
# SPDX-License-Identifier: GPL-2.0-only
#
# For a description of the syntax of this configuration file,
# see Documentation/kbuild/kconfig-language.rst.
#

menu "Qualcomm edac drivers"

config EDAC_KRYO_ARM64
	depends on ARM64
	tristate "ARM KRYO Gold and Silver L1/L2/L3/SCU Caches"
	help
	  Support for error detection and correction on the
	  Kryo3xx Gold and Silver CPUs. Reports errors caught by Kryo3xx
	  ECC mechanism.
	  For debugging issues having to do with stability and overall system
	  health, you should probably say 'Y' here.

config EDAC_KRYO_ARM64_PANIC_ON_CE
	depends on EDAC_KRYO_ARM64
	bool "Panic on correctable errors - Kryo"
	help
	  Forcibly cause a kernel panic on kryo if an correctable error (CE) is
	  detected, even though the error is (by definition) correctable and
	  would otherwise result in no adverse system effects. This can reduce
	  debugging times on hardware which may be operating at voltages or
	  frequencies outside normal specification.
	  For production builds, you should definitely say 'N' here.

config EDAC_KRYO_ARM64_PANIC_ON_UE
	depends on EDAC_KRYO_ARM64
	bool "Panic on uncorrectable errors - kryo"
	help
	  Forcibly cause a kernel panic if an uncorrectable error (UE) is
	  detected. This can reduce debugging times on hardware which may be
	  operating at voltages or frequencies outside normal specification.
	  For production builds, you should probably say 'N' here.

config EDAC_KRYO_ARM64_PANIC_ON_DE
	depends on EDAC_KRYO_ARM64
	bool "Panic on deferred errors - Kryo"
	help
	  Forcibly cause a kernel panic on kryo if an deferred error (DE) is
	  detected, even though the error has (by definition) been deferred.
	  This can reduce debugging times on hardware which may be operating
	  at voltages or frequencies outside normal specification.
	  For production builds, you should definitely say 'N' here.

config EDAC_QCOM
	tristate "QCOM EDAC Controller"
	depends on ARCH_QCOM && QCOM_LLCC
	help
	  Support for error detection and correction on the
	  Qualcomm Technologies, Inc. SoCs.

	  This driver reports Single Bit Errors (SBEs) and Double Bit Errors (DBEs).
	  As of now, it supports error reporting for Last Level Cache Controller (LLCC)
	  of Tag RAM and Data RAM.

	  For debugging issues having to do with stability and overall system
	  health, you should probably say 'Y' here.

config EDAC_QCOM_LCP
	bool "QCOM LLCC LCP/SRP DDR DRAM ECC reporting"
	depends on EDAC_QCOM
	help
	  Enables error detection for DDR DRAM single-bit and double-bit ECC
	  errors reported through the LLCC Last-level Cache Protocol (LCP) /
	  System Read Protocol (SRP) path.

	  When enabled, a second interrupt handler is registered for
	  ddrss_apps_interrupt[1]. It reads the LCP/SRP
	  interrupt status and error-count registers and reports correctable
	  (SB) and uncorrectable (DB) errors via the EDAC subsystem.

	  Say Y if your platform wires ddrss_apps_interrupt[1] to the GIC and
	  populates the second interrupt entry in the LLCC DT node.
	  Say N to save kernel text and avoid requesting the LCP IRQ on
	  platforms that do not support LCP/SRP ECC reporting.

endmenu
```

## drivers/hwmon/Kconfig
```kconfig
# SPDX-License-Identifier: GPL-2.0-only
#
# Hardware monitoring chip drivers configuration
#

if HWMON

comment "Native drivers"

config SENSORS_QTI_AMOLED_ECM
	tristate "Qualcomm Technologies, Inc. AMOLED Current Monitor"
	depends on SPMI
	help
	  Qualcomm Technologies, Inc. ECM driver supports measurement of
	  OLED display power with a time granularity in sub-frame or
	  multiple frames of image data. The measurement can be for a short
	  period (N frames) or a long period (continuous mode).

	  To compile this driver as module, choose M here: the module will
	  be called qti_amoled_ecm.

config SENSORS_QTI_BTL
	tristate "Qualcomm Technologies, Inc. Battery Temperature Logging"
	depends on SPMI
	help
	  Qualcomm Technologies, Inc. Battery temperature logging driver
	  supports reading back how long device spends within a given
	  set of temperature ranges.

	  To compile this driver as module, choose M here: the module will
	  be called qti_btl.

config QTI_BATT_TELEMETRY
	tristate "Qualcomm Technologies, Inc. Battery Telemetry Driver"
	depends on QTI_PMIC_GLINK
	help
	  Enable this driver to support battery voltage and current
	  telemetry data transport from remote sub-system to APPS via
	  pmic_glink GLink channel on Qualcomm Technologies, Inc. platforms.

	  The driver exposes a sysfs interface allowing userspace to
	  start/stop sampling and read raw binary telemetry sample
	  data in a single read call.

	  Say Y or M if you are building for a Qualcomm Technologies, Inc.
	  platform that supports battery telemetry via remote subsystem.

endif # HWMON
```

## drivers/misc/Kconfig
```kconfig
# SPDX-License-Identifier: GPL-2.0-only
#
# Misc strange devices
#

menu "Misc devices"

config QCOM_COINCELL
	tristate "Qualcomm coincell charger support"
	depends on MFD_SPMI_PMIC || COMPILE_TEST
	help
	  This driver supports the coincell block found inside of
	  Qualcomm PMICs.  The coincell charger provides a means to
	  charge a coincell battery or backup capacitor which is used
	  to maintain PMIC register and RTC state in the absence of
	  external power.

config QSEECOM_PROXY
	tristate "To enable qseecom proxy driver for kernel client"
	help
	 qseecom proxy driver serves the kernel clients by providing
	 required ops via call back functions with a minimal framework.
	 These callback functions can be used to start, shutdown and
	 send commands to the trusted apps.

config BOOTMARKER_PROXY
	tristate "To enable Bootmarker proxy driver for kernel client"
	help
	  Bootmarker proxy driver serves the kernel clients by providing
	  required ops via call back functions with a minimal framework.
	  These callback functions can be used to access the place marker.
	  To compile this driver as a module, choose M here.
	  If unsure, say N.

config LKDTM
	tristate "Linux Kernel Dump Test Tool Module"
	depends on DEBUG_FS
	help
	This module enables testing of the different dumping mechanisms by
	inducing system failures at predefined crash points.
	If you don't need it: say N
	Choose M here to compile this code as a module. The module will be
	called lkdtm.

	Documentation on how to use the module can be found in
	Documentation/fault-injection/provoke-crashes.rst

config ISL97900_LED
	tristate "ISL97900_I2C_Driver"
	select REGMAP_I2C
	depends on I2C
	help
	  Support for ISL97900 LED driver IC, using this driver,
	  user can set different values to control the LED current
	  using I2C.

	  Say Y if you want to enable ISL97900 driver.


config QTI_FASTRPC
	tristate "Qualcomm FastRPC"
	depends on ARCH_QCOM || COMPILE_TEST
	depends on RPMSG
	select QCOM_SCM
	select DMA_SHARED_BUFFER
	help
	  Provides a communication mechanism that allows for clients to
	  make remote method invocations across processor boundary to
	  applications DSP processor. Say M if you want to enable this
	  module.

config TPS6286_STEP_DOWN_CONV
	tristate "TPS6286_I2C_Driver"
	select REGMAP_I2C
	depends on I2C
	help
	  Support for TPS6286 synchronous Step-Down Converter with I2C
	  interface. User can set different output voltage presets using
	  I2C and Ramp speed.

	  Say Y if you want to enable TPS6286 driver.

config INA234_CURRENT_MONITOR
        tristate "INA234_I2C_Driver"
        select REGMAP_I2C
        depends on I2C
        help
          Support for INA234 Current Monitor driver IC, using this driver,
          user can set different values to monitor voltage across an external
          sense resistor and reports values for currrent, bus voltage and power
          using I2C.

          Say Y if you want to enable INA234 driver.

config SLG4DC_SIGNAL_IC
	tristate "SLG4DC_I2C_Driver"
	select REGMAP_I2C
	depends on I2C
	help
	  Support for SLG4DC49982 low power driver IC, using this driver,
	  user can set different values to enable power from this small
	  power device using I2C.

	  Say Y if you want to enable SLG4DC driver.

source "$(KCONFIG_EXT_PREFIX)drivers/misc/fl7112/Kconfig"

endmenu
```

## drivers/misc/fl7112/Kconfig
```kconfig
# SPDX-License-Identifier: GPL-2.0

menu "USB3 gpio driver"

config PARADA_PD_FL7112
	tristate "FL7112 DP-IN Bridge"
	depends on I2C
	default m
	help
	The FL7112 serves as the PD controller, managing signal detection and GPIO control.
	When an external device is connected to the TYPEC interface,
	FL7112 is responsible for identifying the input device type,
	such as DP screen casting device or adb debugging device, and then notifying the SOC.
endmenu
```
