## drivers/phy/qualcomm/Kconfig
```kconfig
# SPDX-License-Identifier: GPL-2.0-only
#
# Phy drivers for Qualcomm and Atheros platforms
#

config PHY_QCOM_UFS
	tristate "Qualcomm Technologies, Inc. UFS PHY driver"
	depends on OF && ARCH_QCOM
	select GENERIC_PHY
	help
	  Enables support for UFS PHY on Qualcomm Technologies, Inc.
	  chipsets.
	  This driver together with the UFS PHY controller specific
	  driver enables the UFS PHY support for Qualcomm Technologies, Inc.
	  chips.

if PHY_QCOM_UFS

config PHY_QCOM_UFS_V4
	tristate "Qualcomm Technologies, Inc. UFS V4"
	depends on PHY_QCOM_UFS
	help
	  Support for 7nm UFS QMP phy present on QCOM chipsets.
	  This is required to enable UFS on QCOM chipset.
	  To compile this driver as a module, choose M here.

config PHY_QCOM_UFS_V4_CROW
	tristate "Qualcomm Technologies, Inc. UFS Crow Phy Driver"
	depends on PHY_QCOM_UFS
	help
	  This configuration option adds support for the UFS
	  PHY present on QCOM Crow chipsets.
	  This is required to enable UFS on crow, volcano, chora chipsets.
	  To compile this driver as a module, choose M here.

config PHY_QCOM_UFS_V4_GEN3AUTO
	tristate "Qualcomm Technologies, Inc. UFS gen3auto Phy Driver"
	depends on PHY_QCOM_UFS
	help
	  Support for 7nm UFS QMP phy present on QCOM chipsets.
	  This is required to enable UFS on QCOM chipset.
	  To compile this driver as a module, choose M here.

config PHY_QCOM_UFS_QRBTC_SDM845
	tristate "Qualcomm Technologies, Inc. UFS Presil Phy Driver"
	depends on PHY_QCOM_UFS && REGULATOR_STUB
	help
	  Enable this to support UFS PHY on pre-silicon platforms.
	  The support is restricted to HS-G1 only on both Tx and Rx.
	  No low power mode support is present.
	  Doesn't restrict number of lanes.

config PHY_QCOM_UFS_V4_KALAMA
         tristate "Qualcomm Technologies, Inc. UFS Kalama Phy Driver"
         help
           Support for UFS phy present on QCOM kalama chipsets.
           This is required to enable UFS on Kalama chipset.
           To compile this driver as a module, choose M here.

config PHY_QCOM_UFS_V4_SUN
	tristate "Qualcomm Technologies, Inc. UFS Sun Phy Driver"
	depends on PHY_QCOM_UFS
	help
	  Support for UFS phy present on QCOM Sun chipsets.
	  This is required to enable UFS on Sun chipset.
	  To compile this driver as a module, choose M here.

config PHY_QCOM_UFS_V4_CANOE
	tristate "Qualcomm Technologies, Inc. UFS Canoe Phy Driver"
	depends on PHY_QCOM_UFS
	help
	  This configuration option adds support for the UFS
	  PHY present on QCOM Canoe chipsets.
	  This is required to enable UFS on Canoe chipset.
	  To compile this driver as a module, choose M here.

config PHY_QCOM_UFS_V4_YUPIK
	tristate "Qualcomm Technologies, Inc. UFS Yupik Phy Driver"
	depends on PHY_QCOM_UFS
	help
	  This configuration option adds support for the UFS
	  PHY present on QCOM Yupik chipsets.
	  This is required to enable UFS on Yupik chipset.
	  To compile this driver as a module, choose M here.

config PHY_QCOM_UFS_V4_LAHAINA
	tristate "Qualcomm Technologies, Inc. UFS Lahaina Phy Driver"
	depends on PHY_QCOM_UFS
	help
	  This configuration option adds support for the UFS
	  PHY present on QCOM Lahaina chipsets.
	  This is required to enable UFS on Lahaina chipset.
	  To compile this driver as a module, choose M here.

config PHY_QCOM_UFS_V4_WAIPIO
	tristate "Qualcomm Technologies, Inc. UFS Waipio Phy Driver"
	depends on PHY_QCOM_UFS
	help
	  This configuration option adds support for the UFS
	  PHY present on QCOM Waipio chipsets.
	  This is required to enable UFS on Waipio chipset.
	  To compile this driver as a module, choose M here.

config PHY_QCOM_UFS_V4_DIWALI
	tristate "Qualcomm Technologies, Inc. UFS Diwali Phy Driver"
	depends on PHY_QCOM_UFS
	help
	  This configuration option adds support for the UFS
	  PHY present on QCOM Diwali chipsets.
	  This is required to enable UFS on Diwali chipset.
	  To compile this driver as a module, choose M here.

config PHY_QCOM_SNPS_EUSB2
	tristate "Qualcomm SNPS eUSB2 PHY Driver"
	depends on OF && (ARCH_QCOM || COMPILE_TEST)
	select GENERIC_PHY
	help
	  Enable support for the USB high-speed SNPS eUSB2 phy on Qualcomm
	  chipsets. The PHY is paired with a Synopsys DWC3 USB controller
	  on Qualcomm SOCs. It is required for proper USB functionality on
	  platforms that integrate this PHY, such as certain Snapdragon
	  SoCs. Enable this option if you are building for a Qualcomm
	  platform that uses the SNPS eUSB2 PHY, or if you are performing
	  compile testing for PHY drivers.

config PHY_QCOM_UFS_V3
	tristate "Qualcomm Technologies, Inc. UFS PHY V3 driver"
	depends on PHY_QCOM_UFS
	help
	 Support for 11nm UFS QMP phy present on QCOM chipsets. This
	 configuration option adds support for the UFS PHY present
	 on QCOM Bengal chipsets.
	 This is required to enable UFS on Bengal chipset.
	 To compile this driver as a module, choose M here.

config PHY_QCOM_UFS_V4_KHAJE
	tristate "Qualcomm Technologies, Inc. UFS Khaje Phy Driver"
	depends on PHY_QCOM_UFS
	help
	  This configuration option adds support for the UFS
	  PHY present on QCOM Khaje chipsets.
	  This is required to enable UFS on Khaje chipset.
	  To compile this driver as a module, choose M here.
	  This is good debug.

endif

config PHY_QCOM_EUSB2_REPEATER
	tristate "Qualcomm eUSB2 Repeater Driver"
	depends on OF && (ARCH_QCOM || COMPILE_TEST)
	select GENERIC_PHY
	help
	  Enable support for the USB high-speed eUSB2 repeater on Qualcomm
	  PMICs. The repeater is paired with an eUSB2 Phy on Qualcomm SOCs.
	  This is required for voltage inter-operability between the eUSB2
	  phy and the DP/DM lines connecting the USB host.
	  PMICs. The repeater is paired with a eUSB2 Phy
	  on Qualcomm SOCs.

config PHY_QCOM_M31_EUSB2
	tristate "Qualcomm M31 eUSB2 PHY Driver"
	depends on OF && (ARCH_QCOM || COMPILE_TEST)
	select GENERIC_PHY
	help
	  Enable support for the USB high-speed M31 eUSB2 phy on Qualcomm
	  chipsets. The PHY is paired with a Synopsys DWC3 USB controller
	  on Qualcomm SOCs. This is required for the USB controller to
	  communicate with the USB host in High-Speed mode.

config PHY_QCOM_QMP_COMBO
	tristate "Qualcomm QMP Combo PHY Driver"
	depends on OF && COMMON_CLK && (ARCH_QCOM || COMPILE_TEST)
	depends on TYPEC || TYPEC=n
	depends on DRM || DRM=n
	select GENERIC_PHY
	select MFD_SYSCON
	help
	  Enable this to support the QMP Combo PHY transceiver that is used
	  with USB3 and DisplayPort controllers on Qualcomm chips. This is
	  required for the USB controller to communicate with the USB host
	  in Super-Speed mode.

config PHY_QCOM_SGMII_ETH
	tristate "Qualcomm DWMAC SGMII SerDes/PHY driver"
	depends on OF && (ARCH_QCOM || COMPILE_TEST)
	depends on HAS_IOMEM
	select GENERIC_PHY
	help
	  Enable this to support the Qualcomm SGMII SerDes/PHY used with the
	  DesignWare MAC Ethernet controller on Qualcomm SoCs. This is required
	  for proper SGMII link configuration between the MAC and external PHY.

config PHY_QCOM_QMP_USB
	tristate "Qualcomm QMP USB PHY Driver"
	select GENERIC_PHY
	default PHY_QCOM_QMP
	help
	  Enable this to support the QMP USB PHY transceiver that is used
	  with USB3 controllers on Qualcomm chips.

config PHY_QCOM_UFS_V4_GLYMUR
	tristate "Qualcomm Technologies, Inc. UFS Glymur Phy Driver"
	depends on PHY_QCOM_UFS
	help
	  Enable support for the Qualcomm UFS QMP v4 PHY found on
	  Glymur-based platforms. This driver initializes and manages
	  the UFS PHY used by the UFS controller during link startup and
	  normal operation.
	  Select this option if the target platform uses the Glymur
	  UFS PHY. To build this driver as a module, choose M here.
```

## drivers/platform/arm64/Kconfig
```kconfig
# SPDX-License-Identifier: GPL-2.0

menu "ARM64 Platform-Specific Device Drivers"

config EC_QCOM_GLYMUR
	tristate "Embedded Controller driver for Qualcomm Glymur reference devices"
	depends on ARCH_QCOM || COMPILE_TEST
	depends on I2C
	depends on THERMAL || THERMAL=n
	help
	  Say M or Y here to enable the Embedded Controller driver for Qualcomm
	  Snapdragon-based Glymur reference devices. The driver handles fan
	  control, temperature sensors, access to EC state changes and supports
	  reporting suspend entry/exit to the EC.

	  This driver currently supports Glymur reference devices.

endmenu
```

## drivers/powercap/qcom/Kconfig
```kconfig
# SPDX-License-Identifier: GPL-2.0-only
config QCOM_POWER_TELEMETRY_FRAMEWORK
	tristate "Qualcomm Technologies, Inc. Power Telemetry Hardware Framework"
	depends on POWERCAP
	help
	  This enables Qualcomm Technologies, Inc. power telemetry framework.
	  It provides a framework support to register for different power
	  capable device channels. Based on devicetree power-zones hierarchy,
	  it binds different channels to power-zone node (aka qptm). Each
	  qptm node registers with powercap framework as powercap zones.

config QCOM_POWER_TELEMETRY_HW
	tristate "Qualcomm Technologies, Inc. Power Telemetry Hardware driver"
	depends on NVMEM_SPMI_SDAM
	depends on QCOM_POWER_TELEMETRY_FRAMEWORK
	help
	  This enables Qualcomm Technologies, Inc. power telemetry
	  hardware device driver. It provides power and energy data for different
	  power devices like pmic regulator, bobs etc. It registers each power/energy
	  channel to power telemetry framework.

config QCOM_POWER_TELEMETRY_DATA_SHARE
	tristate "Qualcomm Technologies, Inc. Power Telemetry Data Sharing module"
	depends on QCOM_POWER_TELEMETRY_FRAMEWORK
	help
	  This enables Qualcomm Technologies, Inc. power telemetry
	  data sharing module. It allows sharing of power and energy data collected
	  by the Power Telemetry Hardware driver with other components via a
	  dedicated shared memory data structure.

config QCOM_QPT_RPMSG_POWERCAP
	tristate "Qualcomm Technologies, Inc. QPT RPMSG Powercap driver"
	help
	  This enables Qualcomm Technologies, Inc. QPT RPMSG powercap
	  driver. It provides power capping and power telemetry support
	  for Qualcomm SoCs using the QPT (Qualcomm Power Telemetry)
	  interface over the RPMSG transport mechanism.

config QCOM_SPEL
	tristate "Qualcomm Technologies, Inc. SPEL Power Telemetry Interface module"
	depends on POWERCAP
	help
	  This enables Qualcomm Technologies, Inc. SPEL power telemetry
	  interface module. It provides powercap framework-based interface
	  to the SPEL hardware. The SPEL hardware provides reports detailing
	  consumed energy and enforces operating power limits on the various
	  subsystems.
```

## drivers/usb/dwc3/Kconfig
```kconfig
# SPDX-License-Identifier: GPL-2.0

if USB_DWC3

comment "Platform Glue Driver Support"

config USB_DWC3_MSM
	tristate "QTI MSM Platforms"
	depends on ARCH_QCOM || COMPILE_TEST
	help
	  Applicable to QTI MSM Platforms with DesignWare Core
	  USB3 IP.
	  Driver supports host, device and dual-role modes of operation.
	  Say 'Y' or 'M' if you have one such device.

config USB_DWC3_QCOM_MP
	tristate "Qualcomm Platform"
	depends on ARCH_QCOM || COMPILE_TEST
	depends on EXTCON || !EXTCON
	depends on OF
	default USB_DWC3
	help
	  Some Qualcomm SoCs use DesignWare Core IP for USB2/3
	  functionality.
	  This driver also handles Qscratch wrapper which is needed
	  for peripheral mode support.
	  Say 'Y' or 'M' if you have one such device.

endif
```

## drivers/usb/extcon/Kconfig
```kconfig
# SPDX-License-Identifier: GPL-2.0

menu "ktm5000 driver"

config KTM5000B0T
	tristate "DP2HDMI functionality"
	help
	  Say Y here to enable DP-to-HDMI functionality.With this option
	  enabled, the platform is configured to support concurrent USB
	  3.0 2-lane and DisplayPort 2-lane operation. Enable this option
	  only on platforms that support this mode.
endmenu
```

## sound/usb/Kconfig
```kconfig
# SPDX-License-Identifier: GPL-2.0-only
# ALSA USB drivers

if SND_USB && USB

config SND_USB_AUDIO_QMI
	tristate "USB Audio QMI Service driver"
	depends on QCOM_QMI_HELPERS && SND_USB_AUDIO
	help
	  Starts USB Audio QMI server to communicate with remote entity
	  to perform operations like enable or disable particular audio
	  stream on a connected USB device, subsystem restart and
	  device disconnect.

config SND_USB_AUDIO_QMI_1IR
	tristate "USB Audio QMI One interrupter Service driver"
	depends on QCOM_QMI_HELPERS && SND_USB_AUDIO
	help
	  Starts USB Audio QMI server to communicate with remote entity
	  to perform operations like enable or disable particular audio
	  stream on a connected USB device, subsystem restart and
	  device disconnect. This is one interrupter supported version.

endif	# SND_USB
```
